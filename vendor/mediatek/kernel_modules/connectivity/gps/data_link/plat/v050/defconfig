## vendor/mediatek/kernel_modules/connectivity/gps/data_link/plat/v050/kconfig
```kconfig
config GPS_DL_HAS_MOCK
    bool "Enable mock for gps"
    default n
    help
        Not used

config GPS_DRV_CONTROL_LNA
    bool "Enable control lna by driver"
    default n
    help
        Is the lna controlled by driver
```

## vendor/mediatek/kernel_modules/connectivity/gps/data_link/plat/v061/defconfig
```kconfig
CONFIG_GPS_DL_HAS_MOCK=n
CONFIG_GPS_DRV_CONTROL_LNA=n
CONFIG_GPSMDL=y
CONFIG_GPSMDL_HAL=y
CONFIG_GPSMDL_HW=y
CONFIG_GPSMDL_FW=y
```

## vendor/mediatek/kernel_modules/connectivity/gps/data_link/plat/v062/kconfig
```kconfig
config GPS_DL_HAS_MOCK
    bool "Enable mock for gps"
    default n
    help
        Not used

config GPS_DRV_CONTROL_LNA
    bool "Enable control lna by driver"
    default n
    help
        Is the lna controlled by driver

config GPSMDL
    bool "Enable offload mode"
    default y
    help
        If enable offload mode

config GPSMDL_HAL
    bool "Enable offload mode HAL part"
    depends on GPSMDL
    default y
    help
        If enable offload mode HAL part

config GPSMDL_HW
    bool "Enable offload mode HW part"
    depends on GPSMDL
    default y
    help
        If enable offload mode HW part

config GPSMDL_FW
    bool "Enable offload mode FW part"
    depends on GPSMDL
    default y
    help
        If enable offload mode FW part
```
