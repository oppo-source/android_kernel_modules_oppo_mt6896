## vendor/mediatek/kernel_modules/connectivity/wlan/core/gen4-mt79xx/configs/MT7902/alps/defconfig
```kconfig
CONFIG_SUPPORT_FW_IDX_LOG_TRANS=n
CONFIG_SUPPORT_UPDATE_HE_BSS_COLOR_FROM_BEACON=y
CONFIG_SUPPORT_APF=y
CONFIG_SUPPORT_DFS_OFFLOAD=y
CONFIG_USB_RECYCLE_REQ_IN_IRQ=y

CONFIG_SUPPORT_SINGLE_SKU_LOCAL_DB=n

CONFIG_NUM_DIFFERENT_CHANNELS_STA=1
CONFIG_NUM_DIFFERENT_CHANNELS_P2P=1
CONFIG_DRIVER_INITIAL_RUNNING_MODE=3
CONFIG_ENABLE_WAKE_LOCK=n
CONFIG_DEFAULT_DBG_LEVEL=0xF
CONFIG_TX_DIRECT=y
CONFIG_RX_DIRECT=y
CONFIG_USB_REQ_TX_DATA_FFA_CNT=6
CONFIG_USB_REQ_TX_DATA_CNT=2
CONFIG_USB_REQ_RX_DATA_CNT=4
CONFIG_ENABLE_EFUSE_MAC_ADDR=y
CONFIG_P2P_SCAN_REPORT_ALL_BSS=0
CONFIG_SDIO_RX_AGG_WORKQUE=n

ccflags-y += $(call cc-disable-warning, unused-but-set-variable)
PLATFORM_FLAGS += $(call cc-disable-warning, unused-but-set-variable)
ccflags-y += $(call cc-option,-Wframe-larger-than=4096)
PLATFORM_FLAGS += $(call cc-option,-Wframe-larger-than=4096)
```

## vendor/mediatek/kernel_modules/connectivity/wlan/core/gen4-mt79xx/configs/MT7902/dev_features/defconfig
```kconfig
$(info dev config)

CONFIG_CONNAC2_LISTMODE_ENABLE=n
# For Pwr table compatibility
CONFIG_MTK_WIFI_TXPWR_DAT_FN=y
# For SQC2.7
CONFIG_MTK_WIFI_SUPPORT_6G_PWR_REGS=y
CONFIG_SUPPORT_FW_LOG_TIMESYNC=y
```

## vendor/mediatek/kernel_modules/connectivity/wlan/core/gen4-mt79xx/configs/MT7902/dtv/dtv_main/defconfig
```kconfig
CONFIG_SUPPORT_DFS_OFFLOAD=y
CONFIG_SUPPORT_RX_NAPI=y
CONFIG_DRIVER_INF_NAME_CHANGE=n


CONFIG_CHIP_RESET_USE_DTS_GPIO_NUM=y
CONFIG_CHIP_RESET_USE_LINUX_GPIO_API=y
CONFIG_CHIP_RESET_DTS_COMPATIBLE_NAME='"mediatek,mtk-wifi-reset"'
CONFIG_CHIP_RESET_GPIO_PROPERTY_NAME='"reset-gpio-num"'
CONFIG_CHIP_RESET_INVERT_PROPERTY_NAME='"invert-ms"'
CONFIG_CHIP_RESET_DEFAULT_VAL_PROPERTY_NAME='"default-gpio-val"'

CONFIG_SUPPORT_MTK_SCAN_EVENT=y
CONFIG_SUPPORT_P2P_CSA=y
CONFIG_DBG_PRINT_RTP_INFO=y
CONFIG_SUPPORT_MDNS_OFFLOAD=y
CONFIG_TEST_CODE_FOR_MDNS=y
```

## vendor/mediatek/kernel_modules/connectivity/wlan/core/gen4-mt79xx/configs/MT7922/defconfig
```kconfig
$(info $$MTK_COMBO_CHIP is [MT7922])

ccflags-y:=$(filter-out -UMT7922,$(ccflags-y))
ccflags-y += -DMT7922
CONFIG_SDIO_INTR_ENHANCE_FORMAT=2
# MT7922's max cmd tx resource = 3
# so QM_CMD_RESERVED_THRESHOL must be less than 3
CONFIG_QM_CMD_RESERVED_THRESHOLD=1
CONFIG_MTK_WIFI_CONNAC2X=y
CONFIG_MTK_WIFI_11AX_SUPPORT=y
ifeq ($(call kver_ge,5,4,0),1)
CONFIG_MTK_WIFI_6G_SUPPORT=y
else
CONFIG_MTK_WIFI_6G_SUPPORT=n
endif
CONFIG_MTK_WIFI_TWT_SUPPORT=y
CONFIG_MTK_WIFI_TWT_HOTSPOT_SUPPORT=n
CONFIG_MTK_WIFI_TWT_HOTSPOT_AC_SUPPORT=n
CONFIG_MTK_WIFI_CSI=y
CONFIG_SUPPORT_WIFI_DL_BT_PATCH=n
CONFIG_SUPPORT_PCIE_ASPM=y
CONFIG_SUPPORT_PCIE_ASPM_IMPROVE=n
CONFIG_SUPPORT_CMD_OVER_WFDMA=y
CONFIG_SUPPORT_RETURN_TASK=y
CFG_SUPPORT_HOST_RX_WM_EVENT_FROM_PSE=y
CONFIG_SUPPORT_DEBUG_SOP=y
CONFIG_CONTROL_ASPM_BY_FW=y
ifeq ($(CONFIG_MTK_COMBO_WIFI_HIF), pcie)
CFG_COALESCING_INTERRUPT=y
endif
CONFIG_SUPPORT_SUPPLICANT_SME=y
CONFIG_SUPPORT_OWE=y
CONFIG_REDIRECT_OID_SUPPORT=y
CONFIG_SUPPORT_CFG80211_QUEUE=y
CONFIG_RX_REPORT_FORMAT=2
CONFIG_SUPPORT_BW160=y
CONFIG_WIFI_TX_ETH_CHK_EMPTY_PAYLOAD=y
```

## vendor/mediatek/kernel_modules/connectivity/wlan/core/gen4-mt79xx/configs/MT7926/defconfig
```kconfig
$(info $$MTK_COMBO_CHIP is [MT7926])

ccflags-y:=$(filter-out -UMT7926,$(ccflags-y))
ccflags-y += -DMT7926
CONFIG_SDIO_INTR_ENHANCE_FORMAT=2
CONFIG_SUPPORT_SCHED_SCAN=y
CONFIG_SUPPORT_DUAL_WTBL_GTK_REKEY_OFFLOAD=y
# ccflags-y += -DQM_CMD_RESERVED_THRESHOLD=1
CONFIG_MTK_WIFI_CONNAC2X=y
CONFIG_MTK_WIFI_11AX_SUPPORT=y
ifeq ($(call kver_ge,5,4,0),1)
CONFIG_MTK_WIFI_6G_SUPPORT=y
else
CONFIG_MTK_WIFI_6G_SUPPORT=n
endif
CONFIG_MTK_WIFI_TWT_SUPPORT=y
CONFIG_MTK_WIFI_TWT_HOTSPOT_SUPPORT=y
CONFIG_MTK_WIFI_TWT_HOTSPOT_AC_SUPPORT=n
CONFIG_MTK_WIFI_CSI=y
CONFIG_MTK_WIFI_NAN=y
CONFIG_WIFI_TWT_STAPS_DISABLE_SCAN=n
CONFIG_SUPPORT_WIFI_DL_BT_PATCH=y
CONFIG_SUPPORT_WIFI_DL_ZB_PATCH=y
CONFIG_SUPPORT_PCIE_ASPM=y
CONFIG_SUPPORT_PCIE_ASPM_IMPROVE=n
CONFIG_SUPPORT_WIFI_DL_TEST_MODE=y
CONFIG_SUPPORT_DTIM_SKIP=n
# CONFIG_SUPPORT_CMD_OVER_WFDMA=y
# CFG_SUPPORT_HOST_RX_WM_EVENT_FROM_PSE=y
CONFIG_WIFI_RAM_MQM_BA_DELAY_SUPPORT=n
ifeq ($(CONFIG_MTK_COMBO_WIFI_HIF), sdio)
CONFIG_TX_RSRC_WMM_ENHANCE=y
CONFIG_SUPPORT_MAILBOX_ACK=n
CONFIG_SUPPORT_SDIO_FORCE_DRV_OWN=y
CONFIG_SUPPORT_SDIO_DB_DELAY=y
endif
ifeq ($(CONFIG_MTK_COMBO_WIFI_HIF), pcie)
CFG_COALESCING_INTERRUPT=y
CONFIG_SUPPORT_IPC_WITHOUT_MMIO_READ=y
CONFIG_SUPPORT_DISABLE_DATA_DDONE_INTR=y
CONFIG_RX_WORK_SUPPORT=y
CONFIG_SUPPORT_RX_NAPI=y
endif
CONFIG_SUPPORT_DEBUG_SOP=y
CONFIG_NOT_CLR_FREE_MSDU_IN_ACTIVE_NETWORK=y
# Default disable feature notify country code to zb
CONFIG_SUPPORT_ZB_SKU=n
CFG_SUPPORT_SW_BIP_GMAC=y
CONFIG_SUPPORT_SAP_WPA3_H2E=y
CONFIG_MTK_PASSPOINT_R2_SUPPORT=y
CONFIG_SUPPORT_SAP_OWE=y
CONFIG_USB_RECYCLE_REQ_IN_IRQ=y
CONFIG_SUPPORT_UPDATE_HE_BSS_COLOR_FROM_BEACON=y
CONFIG_SUPPORT_APF=y
CONFIG_SUPPORT_FW_IDX_LOG_TRANS=y

CONFIG_SUPPORT_WOW_EINT=y
CONFIG_SUPPORT_SUPPLICANT_SME=y
CONFIG_SUPPORT_OWE=y
CONFIG_REDIRECT_OID_SUPPORT=y
CONFIG_SUPPORT_CFG80211_QUEUE=y
CONFIG_RX_REPORT_FORMAT=2
CONFIG_SUPPORT_HE_ER=n
CONFIG_SUPPORT_DBDC=y
CONFIG_WIFI_TX_ETH_CHK_EMPTY_PAYLOAD=y
CONFIG_SUPPORT_MDNS_OFFLOAD=y
```

## vendor/mediatek/kernel_modules/connectivity/wlan/core/gen4-mt79xx/configs/MT7926/dev_features/defconfig
```kconfig
$(info dev config)

# For Pwr table compatibility
CONFIG_MTK_WIFI_TXPWR_DAT_FN=y
```

## vendor/mediatek/kernel_modules/connectivity/wlan/core/gen4-mt79xx/configs/MT7961/alps/defconfig
```kconfig
CONFIG_MTK_CONNSYS_DEDICATED_LOG_PATH=n
CONFIG_SUPPORT_DFS_OFFLOAD=n
CONFIG_SUPPORT_FW_IDX_LOG_TRANS=n
CONFIG_SUPPORT_HE_ER=y

ifeq ($(CONFIG_MTK_COMBO_WIFI_HIF), sdio)
CONFIG_CHIP_RESET_KO_SUPPORT=y
CONFIG_SDIO_INTR_ENHANCE_FORMAT=2
CONFIG_CHIP_RESET_USE_MSTAR_GPIO_API=n
endif

ifeq ($(CONFIG_GKI_SUPPORT), y)
CONFIG_DC_USB_WOW_CALLBACK=n
endif

ifeq ($(CONFIG_DRM_MEDIATEK_V2), y)
ccflags-$(CONFIG_DRM_MEDIATEK_V2) += -I$(srctree)/drivers/gpu/drm/mediatek/mediatek_v2/
endif

ccflags-y += -Wno-error=unused-but-set-variable
CONFIG_DEFAULT_DBG_LEVEL=0xF
```

## vendor/mediatek/kernel_modules/connectivity/wlan/core/gen4-mt79xx/configs/MT7961/defconfig
```kconfig
$(info $$MTK_COMBO_CHIP is [MT7961])

ccflags-y:=$(filter-out -UMT7961,$(ccflags-y))
ccflags-y += -DMT7961
CONFIG_SDIO_INTR_ENHANCE_FORMAT=2
CONFIG_SUPPORT_SCHED_SCAN=y
CONFIG_SUPPORT_MDNS_OFFLOAD=y
CONFIG_SUPPORT_DUAL_WTBL_GTK_REKEY_OFFLOAD=y
# MT7961's max cmd tx resource = 3
# so QM_CMD_RESERVED_THRESHOL must be less than 3
CONFIG_QM_CMD_RESERVED_THRESHOLD=1
ifeq ($(CONFIG_MTK_COMBO_WIFI_HIF), pcie)
CONFIG_SUPPORT_WFDMA_REALLOC=n
else
CONFIG_SUPPORT_WFDMA_REALLOC=y
endif
CONFIG_MTK_WIFI_CONNAC2X=y
CONFIG_MTK_WIFI_11AX_SUPPORT=y
# unless patch wifi 6G setting in kernel before kernel version 5.4,
# it will build fail when enable wifi 6G flag
ifeq ($(call kver_ge,5,4,0),1)
CONFIG_MTK_WIFI_6G_SUPPORT=y
else
CONFIG_MTK_WIFI_6G_SUPPORT=n
endif
CONFIG_MTK_WIFI_TWT_SUPPORT=y
CONFIG_MTK_WIFI_TWT_HOTSPOT_SUPPORT=y
CONFIG_MTK_WIFI_TWT_HOTSPOT_AC_SUPPORT=n
CONFIG_MTK_WIFI_CSI=y
CONFIG_WIFI_TWT_STAPS_DISABLE_SCAN=n
CONIFG_WIFI_TWT_WIFI_6E_CERTIFICATION=n
CONFIG_SUPPORT_WIFI_DL_BT_PATCH=y
CONFIG_SUPPORT_PCIE_ASPM=y
CONFIG_SUPPORT_PCIE_ASPM_IMPROVE=n
CONFIG_SUPPORT_CMD_OVER_WFDMA=y
CFG_SUPPORT_HOST_RX_WM_EVENT_FROM_PSE=y
CONFIG_MTK_WIFI_SW_FAST_PATH=n
CONFIG_MTK_DBDC_SW_FOR_P2P_LISTEN=n
CFG_SUPPORT_SW_BIP_GMAC=y
CONFIG_SUPPORT_SAP_WPA3_H2E=y
CONFIG_MTK_PASSPOINT_R2_SUPPORT=y
CONFIG_SUPPORT_SAP_OWE=y
CONFIG_WIFI_RAM_COEX_SPDT_SHR_ANT_CTRL=y
CONFIG_SUPPORT_IPC_WITHOUT_MMIO_READ=y
CONFIG_SUPPORT_DISABLE_DATA_DDONE_INTR=y
CONFIG_SUPPORT_FW_IDX_LOG_TRANS=y
CONFIG_SUPPORT_UPDATE_HE_BSS_COLOR_FROM_BEACON=y
CONFIG_SUPPORT_APF=y
CONFIG_USB_RECYCLE_REQ_IN_IRQ=y
CONFIG_MTK_WIFI_NAN=y
CONFIG_MTK_WIFI_NAN_SUPPORT_R4=n
CONFIG_WIFI_TESTMODE_FW_REDOWNLOAD=y
CONFIG_SUPPORT_DRV_OWN_MODE_CONTROL=y
CONFIG_SUPPORT_FW_IDX_LOG_SAVE=y
CONFIG_MTK_SUPPLICANT_ROAMING_ENHANCE=y
CONFIG_SUPPORT_SAP_TX_FAIRNESS=y
CONFIG_SUPPORT_RTT=n
CONFIG_SUPPORT_RTT_RSTA=n

# Only 11b Test
CONFIG_SUPPORT_11B_DYNAMIC=y

ifeq ($(CONFIG_MTK_COMBO_WIFI_HIF), sdio)
CONFIG_TX_RSRC_WMM_ENHANCE=y
CONFIG_SUPPORT_MAILBOX_ACK=y
endif
ifeq ($(CONFIG_MTK_COMBO_WIFI_HIF), pcie)
CFG_COALESCING_INTERRUPT=y
CONFIG_SUPPORT_PCIE_WFDMA_WMM_SCH=y
CONFIG_RX_WORK_SUPPORT=y
endif
# For Buzzard, only PCIE & USB support
ifneq ($(CONFIG_MTK_COMBO_WIFI_HIF), sdio)
CONFIG_SUPPORT_DEBUG_SOP=y
endif
CONFIG_SUPPORT_WOW_EINT=y
CONFIG_SUPPORT_SUPPLICANT_SME=y
CONFIG_SUPPORT_OWE=y
CONFIG_REDIRECT_OID_SUPPORT=y
CONFIG_SUPPORT_CFG80211_QUEUE=y
CONFIG_RX_REPORT_FORMAT=1
CONFIG_SUPPORT_HE_ER=n
CONFIG_WIFI_FWDL_UMAC_RESERVE_SIZE_PARA=128
CONFIG_WIFI_TX_ETH_CHK_EMPTY_PAYLOAD=y
# Default disable feature notify country code to bt
CONFIG_SUPPORT_BT_SKU=n
# For WAC module API
# y: enable, n: disable
CONFIG_SUPPORT_WAC=n
```

## vendor/mediatek/kernel_modules/connectivity/wlan/core/gen4-mt79xx/configs/MT7961/dtv/defconfig
```kconfig
CONFIG_NUM_DIFFERENT_CHANNELS_STA=1
CONFIG_NUM_DIFFERENT_CHANNELS_P2P=1
CONFIG_DRIVER_INITIAL_RUNNING_MODE=3
CONFIG_ENABLE_WAKE_LOCK=n
CONFIG_DEFAULT_DBG_LEVEL=0xF
CONFIG_TX_DIRECT=y
CONFIG_RX_DIRECT=y
CONFIG_USB_REQ_TX_DATA_FFA_CNT=6
CONFIG_USB_REQ_TX_DATA_CNT=2
CONFIG_USB_REQ_RX_DATA_CNT=4
CONFIG_ENABLE_EFUSE_MAC_ADDR=y
CONFIG_P2P_SCAN_REPORT_ALL_BSS=0
CONFIG_SDIO_RX_AGG_WORKQUE=n

CONFIG_SUPPORT_SINGLE_SKU_LOCAL_DB=n

CONFIG_SUPPORT_TSF_SYNC=y
CONFIG_CHIP_RESET_USB_DISCONNECT=y
CONFIG_POWER_OFF_CTRL_SUPPORT=y
CONFIG_DC_USB_WOW_CALLBACK=y
CONFIG_WIFI_CFG_FN='"wifi_mt7961.cfg"'

CONFIG_SUPPORT_P2P_CSA=y
CONFIG_SUPPORT_DPP=y

# Extend stack limit size to avoid build error
ifeq ($(CONFIG_KASAN), y)
ccflags-y += -Wframe-larger-than=4096
else
ccflags-y += -Wframe-larger-than=1400
endif
ccflags-y += $(call cc-disable-warning, unused-but-set-variable)
PLATFORM_FLAGS += $(call cc-disable-warning, unused-but-set-variable)
```

## vendor/mediatek/kernel_modules/connectivity/wlan/core/gen4-mt79xx/configs/MT7961/dtv/dtv_2105/defconfig
```kconfig
$(warning MTK_ANDROID_VERSION=$(MTK_ANDROID_VERSION))
ifndef MTK_ANDROID_VERSION
MTK_ANDROID_VERSION = v-base
endif
ifneq ($(filter t-% u-% v-% 16-%, $(MTK_ANDROID_VERSION)),)
CFG_SUPPORT_OLD_VENDOR_HAL=n
else
CFG_SUPPORT_OLD_VENDOR_HAL=y
endif

CONFIG_CHIP_RESET_USE_DTS_GPIO_NUM=y
CONFIG_CHIP_RESET_USE_MSTAR_GPIO_API=y
CONFIG_CHIP_RESET_DTS_COMPATIBLE_NAME='"mstar,gpio-wifi-ctl"'
CONFIG_CHIP_RESET_GPIO_PROPERTY_NAME='"wifi-ctl-gpio"'
CONFIG_CHIP_RESET_INVERT_PROPERTY_NAME='"none"'
CONFIG_CHIP_RESET_DEFAULT_VAL_PROPERTY_NAME='"none"'
```

## vendor/mediatek/kernel_modules/connectivity/wlan/core/gen4-mt79xx/configs/MT7961/dtv/dtv_main/defconfig
```kconfig
$(warning MTK_ANDROID_VERSION=$(MTK_ANDROID_VERSION))
# now for android V, MTK_ANDROID_VERSION is not define
ifndef MTK_ANDROID_VERSION
MTK_ANDROID_VERSION = v-base
endif

ifneq ($(filter t-% u-% v-% 16-%, $(MTK_ANDROID_VERSION)),)
ccflags-y += -DCFG_SUPPORT_RESET_TRIGGERED_VENDOR_EVENT=1
endif

CONFIG_SUPPORT_DFS_OFFLOAD=y
CONFIG_SUPPORT_RX_NAPI=y
CONFIG_DRIVER_INF_NAME_CHANGE=n
CONFIG_SCAN_RADIOINFO=y
#0: no mem shrink 1: low mem shrink 2: middle mem shrink 3: high mem shrink
CONFIG_MEM_SHRINK_LEVEL=0

CONFIG_CHIP_RESET_USE_DTS_GPIO_NUM=y
CONFIG_CHIP_RESET_USE_LINUX_GPIO_API=y
CONFIG_CHIP_RESET_DTS_COMPATIBLE_NAME='"mediatek,mtk-wifi-reset"'
CONFIG_CHIP_RESET_GPIO_PROPERTY_NAME='"reset-gpio-num"'
CONFIG_CHIP_RESET_INVERT_PROPERTY_NAME='"invert-ms"'
CONFIG_CHIP_RESET_DEFAULT_VAL_PROPERTY_NAME='"default-gpio-val"'

CONFIG_SUPPORT_MTK_SCAN_EVENT=y
CONFIG_SUPPORT_P2P_CSA=y
CONFIG_DBG_PRINT_RTP_INFO=y
CONFIG_SUPPORT_MDNS_OFFLOAD=y
ifeq ($(filter 16-%, $(MTK_ANDROID_VERSION)),)
CONFIG_TEST_CODE_FOR_MDNS=y
endif
```

## vendor/mediatek/kernel_modules/connectivity/wlan/core/gen4-mt79xx/configs/defconfig
```kconfig
CONFIG_SUPPORT_DEBUG_FS=n
CONFIG_SUPPORT_PROC_FS=y
CONFIG_SUPPORT_AGPS_ASSIST=n
CONFIG_SUPPORT_TSF_USING_BOOTTIME=y
CONFIG_ARP_MONITER_ENABLE=y
CONFIG_DRIVER_INITIAL_RUNNING_MODE=3
```
